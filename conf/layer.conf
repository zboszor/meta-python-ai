## conf/layer.conf
```bitbake
# We have a conf directory, append to BBPATH
BBPATH .= ":${LAYERDIR}"

# We have a recipes directory, add to BBFILES
BBFILES += " \
	${LAYERDIR}/recipes-*/*/*.bb \
	${LAYERDIR}/recipes-*/*/*.bbappend \
"

BBFILES_DYNAMIC += " \
	clang-revival-layer:${LAYERDIR}/dynamic-layers/clang-revival-layer/*/*/*.bb \
	clang-revival-layer:${LAYERDIR}/dynamic-layers/clang-revival-layer/*/*/*.bbappend \
	intel:${LAYERDIR}/dynamic-layers/intel/*/*/*.bb \
	intel:${LAYERDIR}/dynamic-layers/intel/*/*/*.bbappend \
"

BBFILE_COLLECTIONS += "meta-python-ai"
BBFILE_PATTERN_meta-python-ai := "^${LAYERDIR}/"
BBFILE_PRIORITY_meta-python-ai = "8"

LAYERVERSION_meta-python-ai = "1"
LAYERSERIES_COMPAT_meta-python-ai = "whinlatter"

LAYERDEPENDS_meta-python-ai = "core openembedded-layer meta-python virtualization-layer"
LAYERRECOMMENDS_meta-python-ai = "intel clang-revival-layer"
```
